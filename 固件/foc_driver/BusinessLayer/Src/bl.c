/************************************包含头文件*************************************************/
#include <stddef.h>
#include "type.h"
#include "bsp.h"
#include "bsp_can.h"
#include "dl_can.h"
#include "dl_sense.h"
#include "bl_foc.h"
#include "bl.h"


#ifdef _cplusplus
extern "C" {
#endif

/************************************宏定义****************************************************/
/* 状态帧上报周期（ms）。
 * 100 ms = 10 Hz，CAN 总线负载可以忽略，同时人能肉眼看出变化趋势。
 * 调太快（比如 1 ms）会把总线塞满而且没有任何信息量 —— 控制节拍是 1 ms，
 * 但人、上位机、日志都不需要 1 kHz 的数据。 */
#define BL_STATUS_PERIOD_MS                                             (100U)

/* 本工程在总线上的节点号 —— **占位值**，等整车协议表定稿后由系统级分配。
 * 保留这个宏是为了让"身份"这件事在代码里有个位置，而不是散落在 ID 计算里。 */
#define BL_NODE_ID                                                      (0x03U)


/************************************数据类型定义************************************************/
typedef struct _BL_MODULE_T_
{
    U32 last_status_tick;                                               /* 上次上报状态帧的时刻 */
}BL_MODULE_T;


/************************************静态函数声明************************************************/
static BL_MODULE_T * _bl_get_module
(
    VOID
);

static VOID _bl_report_status
(
    VOID
);

static VOID _bl_handle_command
(
    IN  const DL_CAN_FRAME_T *p_frame
);


/************************************静态变量定义************************************************/
static BL_MODULE_T s_bl_module;


/************************************函数实现**************************************************/
/********************************************************************************************
* 函数名称 :   _bl_get_module
* 功能描述 :   获取业务模块实例指针
* 输入参数 :   无
* 输出参数 :   无
* 返回值   :   模块指针
*********************************************************************************************/
static BL_MODULE_T * _bl_get_module
(
    VOID
)
{
    return &s_bl_module;
}

/********************************************************************************************
* 函数名称 :   _bl_report_status
* 功能描述 :   打包并发出状态帧
*
*              数据全部取自 BL 的缓存（bl_motor_get_*），而不是现去调 DL ——
*              保证上报的这一帧是"某一拍决策用的那组数"，可以和控制行为对得上。
*
*              霍尔码单独带在状态帧的高 4 位里，是为了现场排查相序时不用挂调试器：
*              手动慢慢转电机，看码序列是不是 1-3-2-6-4-5，一眼就能判断霍尔对不对。
*
* 输入参数 :   无
* 输出参数 :   无
* 返回值   :   无
*********************************************************************************************/
static VOID _bl_report_status
(
    VOID
)
{
    F32 bus_v;
    U32 bus_mv;
    S32 iu_ma;
    S32 iv_ma;
    F32 temp_mos_c;
    U8  state;
    U8  hall_code;

    bus_v      = bl_motor_get_bus_v();
    iu_ma      = bl_motor_get_phase_ma(0U);
    iv_ma      = bl_motor_get_phase_ma(1U);
    temp_mos_c = bl_motor_get_temp_c(0U);
    state      = (U8)bl_motor_get_state();
    hall_code  = bl_foc_get_hall_code();

    /* 母线电压从 V 换成 mV。
     * 负值钳到 0：ADC 零点漂移偶尔会给出一个很小的负数，(U32) 强转会把 -1 变成
     * 4294967295，接收端会看到一个天文数字。上限不用管 —— dl_can_send_status()
     * 自己会把超量程的值钳到 655.35 V。 */
    if (!(bus_v > 0.0F))
    {
        bus_mv = 0U;
    }
    else
    {
        bus_mv = (U32)(bus_v * 1000.0F);
    }

    (VOID)dl_can_send_status(bus_mv, iu_ma, iv_ma, temp_mos_c, state, hall_code);
}

/********************************************************************************************
* 函数名称 :   _bl_handle_command
* 功能描述 :   处理一帧指令报文
*
*              ⚠️ **目前只做了"能识别、能拒绝"，没有真正解析控制量。**
*                 整车 CAN 协议表还没冻结（见 dl_can.h 里 DL_CAN_ID_* 的说明），
*                 字段布局、缩放系数、字节序都没有依据，现在写一套解析等于替别人定协议，
*                 而且是错的。所以这里只留一个明确的入口：
*
*                 协议表定稿后，在这个函数里做的三件事：
*                   ① 校验长度、校验和（如果有）；
*                   ② 把"使能请求 / 电压指令 / 限幅"解出来；
*                   ③ 调到 bl_motor_request_enable() / bl_motor_set_vq_v()。
*
*                 在此之前，所有功能都只能通过调试器改内存或改 bl_init() 里的默认值来试。
*
* 输入参数 :   p_frame: 收到的报文
* 输出参数 :   无
* 返回值   :   无
*********************************************************************************************/
static VOID _bl_handle_command
(
    IN  const DL_CAN_FRAME_T *p_frame
)
{
    if (p_frame == NULL)
    {
        return;
    }

    /* 长度不对的帧直接丢。留这个判断不是为了现在，而是为了让"校验"这件事
     * 在协议定稿前就已经有位置，不会到时候忘掉。 */
    if (p_frame->len == 0U)
    {
        return;
    }

    /* 有意留空。见上面的说明。 */
}

/********************************************************************************************
* 函数名称 :   bl_init
* 功能描述 :   业务层初始化
*
*              顺序：
*                1. dl_can_init() —— 先注册接收回调，再开控制器。反过来的话，
*                   控制器一开就可能收到帧，而回调还没注册，第一帧会丢。
*                2. bsp_can_start() —— 退出收发器待机，真正接入总线。
*                   这是"要不要上总线"的决定，属于 BL 而不是 BSP。
*                3. bl_motor_init() —— 电机策略层，最后做。它会去探测 DRV8353，
*                   是会动 SPI 的动作；放在 CAN 之后，是因为"能被远程看到"比
*                   "本地先就绪"优先级高 —— 万一后面卡住，至少总线上已经有心跳。
*
* 输入参数 :   无
* 输出参数 :   无
* 返回值   :   TYPE_RET_SUCCESS / TYPE_RET_FAIL
*********************************************************************************************/
TYPE_RET_E bl_init
(
    VOID
)
{
    BL_MODULE_T *p_mod = _bl_get_module();

    p_mod->last_status_tick = bsp_get_tick();

    if (dl_can_init() != TYPE_RET_SUCCESS)
    {
        return TYPE_RET_FAIL;
    }

    bsp_can_start();

    if (bl_motor_init() != TYPE_RET_SUCCESS)
    {
        return TYPE_RET_FAIL;
    }

    return TYPE_RET_SUCCESS;
}

/********************************************************************************************
* 函数名称 :   bl_task_handler
* 功能描述 :   1 ms 控制节拍
*
*              本函数只做"转发"，不含任何逻辑 —— 逻辑全在 bl_motor_task_1ms 里。
*              看起来多此一举，但好处是：以后要加第二个任务（比如第二台电机、
*              或者一个独立的故障记录器），只需要在这里加一行，不用去改电机模块。
*
* 输入参数 :   无
* 输出参数 :   无
* 返回值   :   无
*********************************************************************************************/
VOID bl_task_handler
(
    VOID
)
{
    bl_motor_task_1ms();
}

/********************************************************************************************
* 函数名称 :   bl_task_schedule
* 功能描述 :   后台任务
*
*              做两件事：
*                1. 把 CAN 接收槽里的帧取出来交给处理函数（**只取不解析**，见上）；
*                2. 每 100 ms 发一帧状态。
*
*              为什么取帧要放在这里而不是中断里：中断里只拷进交接槽（DL 的活），
*              解析在主线上下文做（BL 的活）。这样中断延迟是常数，不受协议复杂度影响。
*
* 输入参数 :   无
* 输出参数 :   无
* 返回值   :   无
*********************************************************************************************/
VOID bl_task_schedule
(
    VOID
)
{
    BL_MODULE_T *p_mod = _bl_get_module();
    DL_CAN_FRAME_T frame;
    U32         now;

    /* ── 1. 取帧 ──────────────────────────────────────────────────────────── */
    while (dl_can_poll(&frame) == TRUE)
    {
        _bl_handle_command(&frame);
    }

    /* ── 2. 周期上报 ──────────────────────────────────────────────────────── */
    now = bsp_get_tick();

    if ((now - p_mod->last_status_tick) >= BL_STATUS_PERIOD_MS)
    {
        p_mod->last_status_tick = now;
        _bl_report_status();
    }
}

#ifdef _cplusplus
}
#endif
