/************************************包含头文件*************************************************/
#include "stm32g4xx_hal.h"
#include "type.h"
#include "bsp_mux.h"
#include "bsp_adc.h"
#include "dl_cell.h"
#include "dl_bus.h"


#ifdef _cplusplus
extern "C" {
#endif

/************************************静态变量定义************************************************/
/* 上一次扫描得到的原始码值，下标 1..8（0 不用）。
 * 为什么要缓存：一次选通要等 ~280 µs 建立，如果每个 getter 都现场选通，
 * 上层连着读 8 节就会阻塞 2 ms 以上，而且中途还会互相打断（mux 是全局单例）。 */
static U16  s_dl_cell_raw[DL_CELL_NUM + 1U];
static BOOL s_dl_cell_scanned = FALSE;


/************************************静态函数声明************************************************/
static VOID _dl_cell_wait_settle
(
    VOID
);


/************************************函数实现**************************************************/
/********************************************************************************************
* 函数名称 :   _dl_cell_wait_settle
* 功能描述 :   等模拟开关 + 分压网络建立
*
*               抽头侧 68k 与 ADC 节点 10k∥10k=5k 组成 4.66 kΩ 源阻抗，
*               对 1 nF 滤波电容 τ ≈ 4.7 µs，5τ ≈ 24 µs。
*               这里用空转循环给到 ~250 µs，是 5τ 的十倍，留足余量。
*
*               ⚠️ 不要改成 HAL_Delay(1)：那是最小 1 ms，一轮 8 节就是 8 ms，
*                  而且依赖 SysTick 中断，在中断关闭的上下文里会直接卡死。
*
* 输入参数 :   无
* 输出参数 :   无
* 返回值   :   无
*********************************************************************************************/
static VOID _dl_cell_wait_settle
(
    VOID
)
{
    volatile U32 i;

    for (i = 0U; i < DL_CELL_SETTLE_LOOPS; i++)
    {
        __NOP();
    }
}

/********************************************************************************************
* 函数名称 :   dl_cell_scan
* 功能描述 :   轮询 8 节抽头，刷新缓存
*
*               顺序：选通 → 等建立 → 读对应 ADC → 下一路。
*               T1–T4 走 U_CELL_MUX1 → SC_ADC_A（ADC1 的 idx 3）
*               T5–T8 走 U_CELL_MUX2 → SC_ADC_B（ADC2 的 idx 2）
*
*               ⚠️ 扫描结束时**必须**把 mux 关回全断：
*                  否则最后一个通道的开关一直闭着，那一路的 10k 会长期并到 ADC 节点上，
*                  虽然电气上无害，但下次读到的是"上一路"，很容易误判。
*
* 输入参数 :   无
* 输出参数 :   无
* 返回值   :   无
*********************************************************************************************/
VOID dl_cell_scan
(
    VOID
)
{
    U8  i;
    U16 raw;

    for (i = 1U; i <= DL_CELL_NUM; i++)
    {
        bsp_mux_select(i);
        _dl_cell_wait_settle();

        if (i <= 4U)
        {
            raw = bsp_adc_get_raw(1U, BSP_ADC1_IDX_SC_A);
        }
        else
        {
            raw = bsp_adc_get_raw(2U, BSP_ADC2_IDX_SC_B);
        }

        s_dl_cell_raw[i] = raw;
    }

    bsp_mux_select(BSP_MUX_CH_NONE);

    s_dl_cell_scanned = TRUE;
}

/********************************************************************************************
* 函数名称 :   dl_cell_is_scanned
* 功能描述 :   是否已经完整扫过一轮
*
*               给上层（尤其是 dl_bus 的超容总压）用来判断“现在读到的 0 是没扫过，
*               还是真的 0 V”。没有这个判断，只能靠调用顺序约束，一旦漏调就会静默出错。
*
* 输入参数 :   无
* 输出参数 :   无
* 返回值   :   TRUE = 至少扫过一轮
*********************************************************************************************/
BOOL dl_cell_is_scanned
(
    VOID
)
{
    return s_dl_cell_scanned;
}

/********************************************************************************************
* 函数名称 :   dl_cell_get_tap_mv
* 功能描述 :   第 j 个抽头的绝对电压（mV，相对 GND_SYS）
*
*               换算：Vtap = K × Vadc，K = 14.6（8 路统一，见 dl_cell.h）
*               没有 TEST 修正项了 —— TEST 网络已在 2026-10-30 改版中删除。
*
*               ⚠️ 本函数读的是缓存。没扫过就返回 0，调用者要自己保证 dl_cell_scan()
*                  在跑。返回 0 和"真的 0 V"在这里不可区分，这是刻意的：
*                  宁可让上层看到 0 并去查扫描有没有启动，也不要现场阻塞 280 µs。
*
* 输入参数 :   index: 1 ~ 8
* 输出参数 :   无
* 返回值   :   抽头电压（mV），越界或未扫描返回 0
*********************************************************************************************/
U32 dl_cell_get_tap_mv
(
    IN  U8      index
)
{
    U32 pin_mv;
    F32 tap_mv;

    if ((index < 1U) || (index > DL_CELL_NUM) || (s_dl_cell_scanned != TRUE))
    {
        return 0U;
    }

    pin_mv = bsp_adc_raw_to_mv(s_dl_cell_raw[index]);
    tap_mv = (F32)pin_mv * DL_CELL_TAP_K;

    return (U32)(tap_mv + 0.5F);
}

/********************************************************************************************
* 函数名称 :   dl_cell_get_cell_mv
* 功能描述 :   第 j 节单体电压（mV，带符号）
*
*               第 2–8 节：两个抽头相减，SC− 电位互相抵消，**结果可信**。
*               第 1 节  ：需要 SC− 相对 GND_SYS 的电位，当前原理图没有这个采样通道，
*                          调用者必须自己传；传 0 意味着假设 SC− 与系统地等电位。
*
*               ⚠️ Vtap1 本身也是相对 GND_SYS 的量，所以第 1 节 = Vtap1 − V(SC−)。
* 输入参数 :   index      : 1 ~ 8
*               sc_minus_mv: SC− 相对 GND_SYS 的电位（mV）
* 输出参数 :   无
* 返回值   :   带符号单体电压（mV），越界返回 0
*********************************************************************************************/
S32 dl_cell_get_cell_mv
(
    IN  U8      index,
    IN  U32     sc_minus_mv
)
{
    U32 tap_now;
    U32 tap_prev;

    if ((index < 1U) || (index > DL_CELL_NUM))
    {
        return 0;
    }

    tap_now = dl_cell_get_tap_mv(index);

    /* 第 1 节：下限是 SC−，不是 GND，也不是 0 */
    if (index == 1U)
    {
        return (S32)tap_now - (S32)sc_minus_mv;
    }

    tap_prev = dl_cell_get_tap_mv((U8)(index - 1U));

    return (S32)tap_now - (S32)tap_prev;
}

#ifdef _cplusplus
}
#endif
